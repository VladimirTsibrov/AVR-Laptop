#ifndef LIFE_H
#define LIFE_H

#include "../Task.h"
#include "../Common.h"
#include <string.h>

namespace nsLife
{
    class Life : public Task
    {
    private:
        static const uint8_t rowBytes = 16;
        static const uint16_t fieldSize = 1024;
        static const uint32_t iterationPeriod = 120;

        enum Screen : uint8_t
        {
            startScreen,
            readyScreen,
            runningScreen,
            completeScreen
        };

        inline static const char caption[] PROGMEM = "Game of Life";
        inline static const uint8_t icon[] PROGMEM = {
            0x00, 0x00, 0xF0, 0x02, 0x00, 0xF0, 0x42, 0x88, 0xF1, 0x02, 0x44, 0xF2,
            0x42, 0x44, 0xF2, 0x42, 0xCE, 0xF1, 0x42, 0x44, 0xF0, 0x4E, 0x84, 0xF1,
            0x00, 0x00, 0xF0, 0x00, 0x3C, 0xF0, 0x00, 0x42, 0xF3, 0x00, 0x42, 0xF4,
            0x00, 0x30, 0xF4, 0x00, 0x86, 0xF4, 0x00, 0x89, 0xF4, 0x00, 0x09, 0xF3,
            0x00, 0x61, 0xF0, 0x00, 0x11, 0xF2, 0x00, 0x16, 0xF2, 0x00, 0xE0, 0xF1};

        inline static const uint8_t startBitmap[fieldSize] PROGMEM = {
            0xFF,0xFF,0xFF,0xFF,0xFF,0xFF,0xFF,0xFF,0xFF,0xFF,0xFF,0xFF,
  0xFF,0xFF,0xFF,0xFF,0xFF,0xFF,0xFF,0xFF,0xFF,0xFF,0xFF,0xFF,
  0xFF,0xFF,0xFF,0xFF,0xFF,0xFF,0xFF,0xFF,0x03,0x00,0x00,0x00,
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  0xFF,0xFF,0xFF,0xFF


        };
        inline static const uint8_t completeBitmap[fieldSize] PROGMEM = {};

        Screen screen = startScreen;
        uint8_t rows[3][rowBytes];
        uint32_t randomState = 1;
        uint32_t nextIteration = 0;
        bool startPromptVisible = false;
        uint32_t nextStartPromptToggle = 0;
        volatile bool stateSaved = false;
        volatile bool displayActive = true;
        volatile bool fieldReady = false;
        FsFile stateFile;

        static void addNeighbour(uint8_t value, uint8_t &ones, uint8_t &twos,
                                 uint8_t &fours, uint8_t &eights)
        {
            uint8_t carry = ones & value;
            ones ^= value;
            uint8_t nextCarry = twos & carry;
            twos ^= carry;
            carry = fours & nextCarry;
            fours ^= nextCarry;
            eights ^= carry;
        }

        static uint8_t nextByte(uint8_t topLeft, uint8_t top, uint8_t topRight,
                                uint8_t middleLeft, uint8_t middle, uint8_t middleRight,
                                uint8_t bottomLeft, uint8_t bottom, uint8_t bottomRight)
        {
            uint8_t ones = 0;
            uint8_t twos = 0;
            uint8_t fours = 0;
            uint8_t eights = 0;

            addNeighbour((uint8_t)((top >> 1) | (topLeft << 7)), ones, twos, fours, eights);
            addNeighbour(top, ones, twos, fours, eights);
            addNeighbour((uint8_t)((top << 1) | (topRight >> 7)), ones, twos, fours, eights);
            addNeighbour((uint8_t)((middle >> 1) | (middleLeft << 7)), ones, twos, fours, eights);
            addNeighbour((uint8_t)((middle << 1) | (middleRight >> 7)), ones, twos, fours, eights);
            addNeighbour((uint8_t)((bottom >> 1) | (bottomLeft << 7)), ones, twos, fours, eights);
            addNeighbour(bottom, ones, twos, fours, eights);
            addNeighbour((uint8_t)((bottom << 1) | (bottomRight >> 7)), ones, twos, fours, eights);

            const uint8_t noHigherBits = (uint8_t)~(fours | eights);
            const uint8_t countThree = ones & twos & noHigherBits;
            const uint8_t countTwo = (uint8_t)~ones & twos & noHigherBits;
            return countThree | (middle & countTwo);
        }

        uint32_t nextRandom()
        {
            randomState ^= randomState << 13;
            randomState ^= randomState >> 17;
            randomState ^= randomState << 5;
            return randomState;
        }

        static uint16_t fieldChecksum()
        {
            const uint8_t *field = lcd.getFrameBuffer();
            uint16_t sum = 0;
            for (uint16_t i = 0; i < fieldSize; i++)
                sum = (uint16_t)(sum + field[i]);
            return sum;
        }

        void drawSplash(const uint8_t *bitmap)
        {
            lcd.cls();
            lcd.drawXBM(bitmap, 128, 64);
        }

        void renderStart(bool showPrompt)
        {
            drawSplash(startBitmap);
            if (showPrompt)
            {
                lcd.setPrintPos(32, 61);
                lcd.print(F("press space"), modeSet);
            }
        }

        void resetStartSplash()
        {
            startPromptVisible = false;
            nextStartPromptToggle = millis() + 1000UL;
            renderStart(false);
        }

        void updateStartSplash()
        {
            if ((int32_t)(millis() - nextStartPromptToggle) < 0)
                return;
            startPromptVisible = !startPromptVisible;
            nextStartPromptToggle = millis() + 1000UL;
            renderStart(startPromptVisible);
        }

        void generate()
        {
            uint8_t *field = lcd.getFrameBuffer();
            randomState ^= micros();
            if (randomState == 0)
                randomState = 1;

            for (uint16_t i = 0; i < fieldSize; i++)
                field[i] = (uint8_t)nextRandom();
            for (uint8_t y = 0; y < 64; y++)
                lcd.markDirtyLine(y);

            stateSaved = false;
            fieldReady = true;
            screen = readyScreen;
        }

        bool iterate()
        {
            uint8_t *field = lcd.getFrameBuffer();
            bool changed = false;
            bool anyAlive = false;
            memset(rows[0], 0, rowBytes);
            memcpy(rows[1], field, rowBytes);
            memcpy(rows[2], field + rowBytes, rowBytes);

            for (uint8_t y = 0; y < 64; y++)
            {
                uint8_t nextRow[rowBytes];
                for (uint8_t byte = 0; byte < rowBytes; byte++)
                {
                    const uint8_t topLeft = byte ? rows[0][byte - 1] : 0;
                    const uint8_t middleLeft = byte ? rows[1][byte - 1] : 0;
                    const uint8_t bottomLeft = byte ? rows[2][byte - 1] : 0;
                    const uint8_t topRight = byte + 1 < rowBytes ? rows[0][byte + 1] : 0;
                    const uint8_t middleRight = byte + 1 < rowBytes ? rows[1][byte + 1] : 0;
                    const uint8_t bottomRight = byte + 1 < rowBytes ? rows[2][byte + 1] : 0;
                    nextRow[byte] = nextByte(topLeft, rows[0][byte], topRight,
                                             middleLeft, rows[1][byte], middleRight,
                                             bottomLeft, rows[2][byte], bottomRight);
                    anyAlive |= nextRow[byte] != 0;
                }
                if (memcmp(field + (uint16_t)y * rowBytes, nextRow, rowBytes) != 0)
                {
                    changed = true;
                    memcpy(field + (uint16_t)y * rowBytes, nextRow, rowBytes);
                    lcd.markDirtyLine(y);
                }

                memcpy(rows[0], rows[1], rowBytes);
                memcpy(rows[1], rows[2], rowBytes);
                if (y < 62)
                    memcpy(rows[2], field + (uint16_t)(y + 2) * rowBytes, rowBytes);
                else
                    memset(rows[2], 0, rowBytes);
            }
            return changed && anyAlive;
        }

        bool saveState()
        {
            const uint16_t beforeChecksum = fieldChecksum();
            if (stateFile)
                stateFile.close();
            sdCard.mkdir("/games/life", true);
            if (!stateFile.open("/games/life/tmp", O_RDWR | O_CREAT))
            {
                return false;
            }
            if (!stateFile.truncate(0))
            {
                stateFile.close();
                return false;
            }
            const size_t written = stateFile.write(lcd.getFrameBuffer(), fieldSize);
            const bool synced = written == fieldSize && stateFile.sync();
            stateFile.close();
            return synced;
        }

        bool restoreState()
        {
            if (stateFile)
                stateFile.close();
            if (!stateFile.open("/games/life/tmp", O_RDONLY))
            {
                return false;
            }
            const uint32_t fileSize = stateFile.fileSize();
            const size_t read = stateFile.read(lcd.getFrameBuffer(), fieldSize);
            stateFile.close();
            const bool restored = read == fieldSize;
            if (restored)
                for (uint8_t y = 0; y < 64; y++)
                    lcd.markDirtyLine(y);
            return restored;
        }

    public:
        static const __FlashStringHelper *getCaption() { return reinterpret_cast<const __FlashStringHelper *>(caption); }
        static const uint8_t *getIcon() { return icon; }
        const __FlashStringHelper *getTaskCaption() const override { return getCaption(); }
        uint16_t getStackSize() const override { return 320; }

    protected:
        void setup() override
        {
            resetStartSplash();
        }

        void loop() override
        {
            if (keyboard.take(keyEsc))
            {
                if (screen == startScreen)
                    requestClose();
                else
                {
                    stateSaved = false;
                    fieldReady = false;
                    screen = startScreen;
                    resetStartSplash();
                }
                vTaskDelay(pdMS_TO_TICKS(25));
                return;
            }

            if (displayActive && screen == startScreen)
                updateStartSplash();

            if (displayActive && fieldReady && screen == readyScreen && keyboard.take(keyR))
                generate();

            if (displayActive && keyboard.take(keySpace))
            {
                if (screen == startScreen || screen == completeScreen)
                    generate();
                else if (fieldReady && screen == readyScreen)
                {
                    screen = runningScreen;
                    nextIteration = millis();
                }
            }

            if (displayActive && fieldReady && screen == runningScreen &&
                (int32_t)(millis() - nextIteration) >= 0)
            {
                if (!iterate())
                {
                    screen = completeScreen;
                    drawSplash(completeBitmap);
                }
                nextIteration += iterationPeriod;
            }
            vTaskDelay(pdMS_TO_TICKS(25));
        }

        void onBackground() override
        {
            displayActive = false;
            if (screen == readyScreen || screen == runningScreen)
            {
                stateSaved = saveState();
                fieldReady = false;
            }
        }

        void onForeground() override
        {
            displayActive = false;
            fieldReady = false;
            if (stateSaved && restoreState())
            {
                stateSaved = false;
                fieldReady = true;
                nextIteration = millis() + iterationPeriod;
                displayActive = true;
                return;
            }
            if (screen == readyScreen || screen == runningScreen)
            {
                stateSaved = false;
                fieldReady = false;
                screen = startScreen;
            }
            if (screen == startScreen)
                resetStartSplash();
            else if (screen == completeScreen)
                drawSplash(completeBitmap);
            displayActive = true;
        }

        void onClosing() override
        {
            if (stateFile)
                stateFile.close();
        }
    };
}

#endif // LIFE_H
