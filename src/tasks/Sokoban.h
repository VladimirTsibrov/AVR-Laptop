#ifndef SOKOBAN_H
#define SOKOBAN_H

#include "../Task.h"
#include "../VS1053.h"
#include <string.h>

namespace nsSokoban
{
    class Sokoban : public Task
    {
    private:
        static const uint8_t mapWidth = 16;
        static const uint8_t mapHeight = 8;
        static const uint8_t mapSize = mapWidth * mapHeight;
        static const uint8_t musicNameSize = 32;

        enum Cell : uint8_t
        {
            wall,
            floor,
            goal,
            box,
            boxOnGoal
        };
        enum Screen : uint8_t
        {
            startScreen,
            gameScreen,
            transitionScreen,
            completeScreen
        };

        inline static const char caption[] PROGMEM = "Sokoban";
        inline static const uint8_t icon[] PROGMEM = {
            0xff, 0xff, 0xff, 0x01, 0x00, 0xf8, 0x05, 0x00, 0xfa, 0x01, 0x00, 0xf8,
            0xff, 0xff, 0xff, 0x49, 0x32, 0xfa, 0x49, 0x12, 0xf9, 0x49, 0x8a, 0xf9,
            0x49, 0x46, 0xf9, 0x49, 0x22, 0xf9, 0x49, 0x31, 0xf9, 0xc9, 0x28, 0xf9,
            0x49, 0x24, 0xf9, 0x29, 0x26, 0xf9, 0x19, 0x25, 0xf9, 0xff, 0xff, 0xff,
            0x01, 0x00, 0xf8, 0x05, 0x00, 0xfa, 0x01, 0x00, 0xf8, 0xff, 0xff, 0xff};

        inline static const uint8_t startBitmap[1024] PROGMEM = {
            0xFF, 0xFF, 0xFF, 0xFF, 0xFF, 0xFF, 0xFF, 0xFF, 0xFF, 0xFF, 0xFF, 0xFF,
            0xFF, 0xFF, 0xFF, 0xFF, 0xFF, 0xFF, 0xFF, 0xFF, 0xFF, 0xFF, 0xFF, 0xFF,
            0xFF, 0xFF, 0xFF, 0xFF, 0xFF, 0xFF, 0xFF, 0xFF, 0x03, 0x00, 0x00, 0x00,
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            0xFF, 0xFF, 0xFF, 0xFF};
        inline static const uint8_t completeBitmap[1024] PROGMEM = {
            0x00, 0x00, 0x00, 0x00, 0x00, 0x00, 0x00, 0x00, 0x00, 0x00, 0x00, 0x00,
            0x00, 0x00, 0x00, 0x00, 0x00, 0x00, 0x00, 0x00, 0x00, 0x00, 0x00, 0x00,
            0x00, 0x00, 0x00, 0x00, 0x00, 0x00, 0x00, 0x00, 0x00, 0x00, 0x00, 0x00,
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            0x00, 0x00, 0x00, 0x00};
        // XBM-тайлы 8x8: wall, floor, goal, box, box-on-goal, player, player-on-goal.
        inline static const uint8_t tiles[7][8] PROGMEM = {
            {0x00, 0xbf, 0xbf, 0xbf, 0x00, 0xfb, 0xfb, 0xfb},
            {0x00, 0x00, 0x00, 0x00, 0x00, 0x00, 0x00, 0x00},
            {0x00, 0x00, 0x24, 0x18, 0x18, 0x24, 0x00, 0x00},
            {0xff, 0xc3, 0xa5, 0x99, 0x99, 0xa5, 0xc3, 0xff},
            {0xff, 0xff, 0xdb, 0xe7, 0xe7, 0xdb, 0xff, 0xff},
            {0x38, 0x38, 0x10, 0x7c, 0x10, 0x28, 0x44, 0x00},
            {0xc7, 0xc7, 0xef, 0x83, 0xef, 0xd7, 0xbb, 0xff}};

        uint8_t cells[mapSize];
        uint8_t initialCells[mapSize];
        uint8_t player = 0;
        uint8_t initialPlayer = 0;
        uint8_t previousPlayer = 0;
        uint8_t movedBoxFrom = 0;
        uint8_t movedBoxTo = 0;
        uint16_t level = 0;
        Screen screen = startScreen;
        bool undoAvailable = false;
        bool previousMovePushedBox = false;
        bool startPromptVisible = false;
        uint32_t nextStartPromptToggle = 0;
        bool displayActive = true;
        uint32_t transitionStartedAt = 0;
        uint16_t transitionDots = 0;
        uint16_t transitionRandom = 0xACE1;

        static const uint16_t transitionDurationMs = 1500;
        static const uint16_t transitionDotCount = 2048;

        FsFile musicFile;
        FsFile musicDirectory;
        FsFile levelsFile;
        char musicName[musicNameSize];
        bool audioAcquired = false;

        uint16_t getStackSize() const override { return 320; }

        static bool isMapChar(char ch)
        {
            return ch == '#' || ch == '@' || ch == '+' || ch == '$' || ch == '*' ||
                   ch == '.' || ch == ' ';
        }

        static Cell cellFromChar(char ch)
        {
            return ch == '#' ? wall : ch == '.' || ch == '+' ? goal
                                  : ch == '$' || ch == '*'   ? (ch == '*' ? boxOnGoal : box)
                                                             : floor;
        }

        void closeMusic()
        {
            if (musicFile)
                musicFile.close();
            if (musicDirectory)
                musicDirectory.close();
            if (audioAcquired)
            {
                vs1053.clearBuffer();
                vs1053.release();
                audioAcquired = false;
            }
        }

        void closeFiles()
        {
            if (levelsFile)
                levelsFile.close();
        }

        static bool isMp3Name(const char *name)
        {
            uint8_t length = strlen(name);
            if (length < 5 || name[length - 4] != '.')
                return false;
            return (name[length - 3] | 0x20) == 'm' &&
                   (name[length - 2] | 0x20) == 'p' &&
                   (name[length - 1] | 0x20) == '3';
        }

        bool openNextMusic()
        {
            SchedulerSuspender lock;
            if (musicFile)
                musicFile.close();
            for (uint8_t pass = 0; pass < 2; pass++)
            {
                while (musicFile.openNext(&musicDirectory, O_RDONLY))
                {
                    musicFile.getName(musicName, sizeof(musicName));
                    musicName[sizeof(musicName) - 1] = '\0';
                    if (!musicFile.isDirectory() && isMp3Name(musicName))
                        return true;
                    musicFile.close();
                }
                musicDirectory.rewindDirectory();
            }
            return false;
        }

        void startMusic()
        {
            closeMusic();
            if (!vs1053.acquire())
                return;
            audioAcquired = true;
            if (!musicDirectory.open("/games/sokoban/music", O_RDONLY) || !openNextMusic())
                closeMusic();
        }

        void feedMusic()
        {
            if (!audioAcquired || !musicFile)
                return;
            if (!musicFile.available())
            {
                if (!openNextMusic())
                    closeMusic();
                return;
            }
            vs1053.feedFile(musicFile);
        }

        bool loadLevel(uint16_t wantedLevel)
        {
            SchedulerSuspender lock;
            if (levelsFile)
                levelsFile.close();
            if (!levelsFile.open("/games/sokoban/levels.xsb", O_RDONLY))
                return false;

            memset(cells, wall, sizeof(cells));
            uint16_t currentLevel = 0;
            uint8_t row = 0;
            uint8_t column = 0;
            bool levelHasContent = false;
            bool hasPlayer = false;
            while (levelsFile.available())
            {
                int value = levelsFile.read();
                if (value == '\r')
                    continue;
                if (value != '\n')
                {
                    if (currentLevel == wantedLevel && row < mapHeight && column < mapWidth)
                    {
                        char cellChar = isMapChar((char)value) ? (char)value : '#';
                        cells[row * mapWidth + column] = cellFromChar(cellChar);
                        if (cellChar == '@' || cellChar == '+')
                        {
                            if (hasPlayer)
                            {
                                levelsFile.close();
                                return false;
                            }
                            player = row * mapWidth + column;
                            hasPlayer = true;
                        }
                    }
                    column++;
                    continue;
                }

                if (column != 0)
                {
                    levelHasContent = true;
                    if (currentLevel == wantedLevel)
                        row++;
                    column = 0;
                    continue;
                }

                if (!levelHasContent)
                    continue;
                if (currentLevel == wantedLevel)
                {
                    levelsFile.close();
                    if (!hasPlayer)
                        return false;
                    memcpy(initialCells, cells, sizeof(cells));
                    initialPlayer = player;
                    undoAvailable = false;
                    return true;
                }
                currentLevel++;
                memset(cells, wall, sizeof(cells));
                row = 0;
                hasPlayer = false;
                levelHasContent = false;
            }
            levelsFile.close();
            if (currentLevel != wantedLevel || !levelHasContent || !hasPlayer)
                return false;

            memcpy(initialCells, cells, sizeof(cells));
            initialPlayer = player;
            undoAvailable = false;
            return true;
        }

        uint8_t tileFor(uint8_t position) const
        {
            if (position == player)
                return cells[position] == goal ? 6 : 5;
            return cells[position];
        }

        void renderLevel()
        {
            for (uint8_t y = 0; y < mapHeight; y++)
                for (uint8_t x = 0; x < mapWidth; x++)
                    lcd.drawXBM(tiles[tileFor(y * mapWidth + x)], 8, 8, x * 8, y * 8);
            lcd.repaint();
        }

        void renderStart(bool showPrompt)
        {
            lcd.cls();
            lcd.drawXBM(startBitmap, 128, 64);
            if (showPrompt)
            {
                lcd.setPrintPos(32, 61);
                lcd.print(F("press space"), modeSet);
            }
        }

        void resetStartSplash()
        {
            startPromptVisible = false;
            nextStartPromptToggle = millis() + 1000UL;
            renderStart(false);
        }

        void updateStartSplash()
        {
            if ((int32_t)(millis() - nextStartPromptToggle) < 0)
                return;
            startPromptVisible = !startPromptVisible;
            nextStartPromptToggle = millis() + 1000UL;
            renderStart(startPromptVisible);
        }

        void renderComplete()
        {
            lcd.cls();
            lcd.drawXBM(completeBitmap, 128, 64);
            lcd.setPrintPos(20, 28);
            lcd.print(F("Level complete"));
            lcd.setPrintPos(14, 44);
            lcd.print(F("Space to continue"));
            lcd.repaint();
        }

        void startTransition()
        {
            screen = transitionScreen;
            transitionStartedAt = millis();
            transitionDots = 0;
            transitionRandom = (uint16_t)(millis() | 1);
        }

        void updateTransition()
        {
            if (!displayActive)
                return;

            uint32_t elapsed = millis() - transitionStartedAt;
            uint16_t targetDots = elapsed >= transitionDurationMs
                                      ? transitionDotCount
                                      : (uint32_t)elapsed * transitionDotCount / transitionDurationMs;
            while (transitionDots < targetDots)
            {
                transitionRandom ^= transitionRandom << 7;
                transitionRandom ^= transitionRandom >> 9;
                transitionRandom ^= transitionRandom << 8;
                uint16_t position = transitionRandom & 0x1FFF;
                uint8_t x = position & 127;
                uint8_t y = position >> 7;
                lcd.setPixel(x, y, modeClear);
                if (x < Display::width() - 1)
                    lcd.setPixel(x + 1, y, modeClear);
                if (y < Display::height() - 1)
                {
                    lcd.setPixel(x, y + 1, modeClear);
                    if (x < Display::width() - 1)
                        lcd.setPixel(x + 1, y + 1, modeClear);
                }
                transitionDots++;
            }

            if (transitionDots == transitionDotCount)
            {
                screen = completeScreen;
                renderComplete();
            }
        }

        bool isComplete() const
        {
            for (uint8_t i = 0; i < mapSize; i++)
                if (cells[i] == box)
                    return false;
            return true;
        }

        void undo()
        {
            if (!undoAvailable)
                return;
            player = previousPlayer;
            if (previousMovePushedBox)
            {
                cells[movedBoxFrom] = cells[movedBoxFrom] == goal ? boxOnGoal : box;
                cells[movedBoxTo] = cells[movedBoxTo] == boxOnGoal ? goal : floor;
            }
            undoAvailable = false;
            renderLevel();
        }

        void move(int8_t dx, int8_t dy)
        {
            int8_t x = player % mapWidth;
            int8_t y = player / mapWidth;
            int8_t nextX = x + dx;
            int8_t nextY = y + dy;
            if (nextX < 0 || nextX >= mapWidth || nextY < 0 || nextY >= mapHeight)
                return;
            uint8_t next = nextY * mapWidth + nextX;
            if (cells[next] == wall)
                return;

            previousPlayer = player;
            previousMovePushedBox = false;
            if (cells[next] == box || cells[next] == boxOnGoal)
            {
                int8_t boxX = nextX + dx;
                int8_t boxY = nextY + dy;
                if (boxX < 0 || boxX >= mapWidth || boxY < 0 || boxY >= mapHeight)
                    return;
                uint8_t destination = boxY * mapWidth + boxX;
                if (cells[destination] != floor && cells[destination] != goal)
                    return;
                movedBoxFrom = next;
                movedBoxTo = destination;
                cells[destination] = cells[destination] == goal ? boxOnGoal : box;
                cells[next] = cells[next] == boxOnGoal ? goal : floor;
                previousMovePushedBox = true;
            }
            player = next;
            undoAvailable = true;
            renderLevel();
            if (isComplete())
                startTransition();
        }

        void restartLevel()
        {
            memcpy(cells, initialCells, sizeof(cells));
            player = initialPlayer;
            undoAvailable = false;
            renderLevel();
        }

        void startLevel()
        {
            if (!loadLevel(level))
            {
                level = 0;
                screen = startScreen;
                resetStartSplash();
                return;
            }
            screen = gameScreen;
            renderLevel();
        }

    public:
        static const __FlashStringHelper *getCaption() { return reinterpret_cast<const __FlashStringHelper*>(caption); }
        static const uint8_t *getIcon() { return icon; }
        const __FlashStringHelper *getTaskCaption() const override { return getCaption(); }
        ~Sokoban() override { closeFiles(); }
        void fullRepaint() override
        {
            if (screen == startScreen)
                resetStartSplash();
            else if (screen == transitionScreen || screen == completeScreen)
                renderComplete();
            else
                renderLevel();
        }
        void onBackground() override
        {
            displayActive = false;
        }
        void onForeground() override
        {
            displayActive = true;
            if (screen == transitionScreen)
            {
                screen = completeScreen;
                renderComplete();
            }
            else
            {
                fullRepaint();
            }
        }

    protected:
        void setup() override
        {
            startMusic();
            resetStartSplash();
        }
        void onClosing() override
        {
            closeMusic();
            closeFiles();
        }
        void loop() override
        {
            if (keyboard.take(keyEsc))
            {
                if (screen == startScreen)
                {
                    requestClose();
                }
                else
                {
                    screen = startScreen;
                    resetStartSplash();
                }
                return;
            }
            if (screen == startScreen)
            {
                updateStartSplash();
                if (keyboard.take(keySpace) || keyboard.take(keyEnter))
                {
                    level = 0;
                    startLevel();
                }
            }
            else if (screen == transitionScreen)
            {
                updateTransition();
            }
            else if (screen == completeScreen)
            {
                if (keyboard.take(keySpace) || keyboard.take(keyEnter))
                {
                    level++;
                    startLevel();
                }
            }
            else
            {
                if (keyboard.take(keyZ))
                    undo();
                else if (keyboard.take(keyR))
                    restartLevel();
                else if (keyboard.take(keyUp))
                    move(0, -1);
                else if (keyboard.take(keyDown))
                    move(0, 1);
                else if (keyboard.take(keyLeft))
                    move(-1, 0);
                else if (keyboard.take(keyRight))
                    move(1, 0);
            }
            feedMusic();
            taskYIELD();
        }
    };
}

#endif // SOKOBAN_H
